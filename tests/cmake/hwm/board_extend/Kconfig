## tests/cmake/hwm/board_extend/Kconfig
```kconfig
# Copyright (c) 2024 Nordic Semiconductor ASA
#
# SPDX-License-Identifier: Apache-2.0

config BASE_BOARD_SETTING
	bool "Base board test string"
	help
	  This kconfig is set when the base board config fragment is supposed to
	  be sourced, that is when oot variant defines
	  'extends:'
	  '  board: native_sim'
	  '  qualifier: posix'
	  '  inherit: 1'

config SET_BY_NATIVE_SIM
	bool "Should be set by native_sim_defconfig"
	default n

config SET_BY_NATIVE_SIM_NATIVE
	bool "Should be set by native_sim_native_defconfig"
	default n

config SET_BY_NATIVE_SIM_NATIVE_64
	bool "Should be set by native_sim_native_64_defconfig"
	default n

config SET_BY_NATIVE_SIM_NATIVE_64_TWO
	bool "Should be set by native_sim_native_64_two_defconfig"
	default n

config SET_BY_NATIVE_SIM_NATIVE_32
	bool "Set in native_sim_native_32_defconfig, so should remain unset"
	default n

config SET_BY_NATIVE_SI # intentionally missing 'M'
	bool "Set in native_si_defconfig, so should remain unset"

config SET_BY_NATIVE # intentionally missing 'SIM'
	bool "Set in native_defconfig, so should remain unset"

source "Kconfig.zephyr"
```

## tests/cmake/hwm/board_extend/oot_root/boards/native/native_sim_extend/native_sim_defconfig
```kconfig
# Copyright (c) 2025 Meta Platforms, Inc. and affiliates
# SPDX-License-Identifier: Apache-2.0

CONFIG_SET_BY_NATIVE_SIM=y
```
